## esp/components/gateway_core/Kconfig.projbuild
```kconfig
menu "BLE Gateway"

    config GW_CONFIG_BUTTON_GPIO
        int "Configuration button GPIO (active low)"
        range 0 28
        default 28
        help
            配置按钮低电平有效，按住三秒打开配网页面
            ESP32-C5 开发板 BOOT 按钮通常连接 GPIO28

endmenu
```

## esp/sdkconfig.defaults
```kconfig
# ESP32-C5 的蓝牙容量配置在 sdkconfig.defaults.esp32c5 中
CONFIG_ESPTOOLPY_FLASHSIZE_32MB=y
CONFIG_PARTITION_TABLE_CUSTOM=y
CONFIG_PARTITION_TABLE_CUSTOM_FILENAME="partitions.csv"
CONFIG_MBEDTLS_CERTIFICATE_BUNDLE=y

# 限制导入 JSON 的递归深度，适配本地 HTTP 任务栈
CONFIG_CJSON_NESTING_LIMIT=16

CONFIG_HTTPD_WS_SUPPORT=y
```

## esp/sdkconfig.defaults.esp32c5
```kconfig
# 保留原有 BLE 4.2 扫描与 GATT 客户端接口
CONFIG_BT_ENABLED=y
CONFIG_BT_CONTROLLER_ENABLED=y
CONFIG_BT_BLUEDROID_ENABLED=y
CONFIG_BT_BLE_ENABLED=y
CONFIG_BT_BLE_42_FEATURES_SUPPORTED=y
CONFIG_BT_BLE_42_SCAN_EN=y
# CONFIG_BT_BLE_50_FEATURES_SUPPORTED is not set
CONFIG_BT_GATTC_ENABLE=y
# CONFIG_BT_GATTS_ENABLE is not set
CONFIG_BT_MULTI_CONNECTION_ENBALE=y
CONFIG_BT_LE_MAX_CONNECTIONS=32
CONFIG_BT_ACL_CONNECTIONS=32
CONFIG_BT_GATTC_NOTIF_REG_MAX=128
CONFIG_BT_SMP_MAX_BONDS=32
CONFIG_BT_BLE_DYNAMIC_ENV_MEMORY=y
CONFIG_BT_ALLOCATION_FROM_SPIRAM_FIRST=y
CONFIG_ESP_COEX_SW_COEXIST_ENABLE=y
CONFIG_GW_CONFIG_BUTTON_GPIO=28

# N32R8 使用 8 MiB Quad PSRAM，容量由启动时自动探测
CONFIG_SPIRAM=y
CONFIG_SPIRAM_MODE_QUAD=y
CONFIG_SPIRAM_SPEED_80M=y
CONFIG_SPIRAM_BOOT_INIT=y
CONFIG_SPIRAM_MEMTEST=y
# CONFIG_SPIRAM_IGNORE_NOTFOUND is not set
CONFIG_SPIRAM_USE_MALLOC=y
CONFIG_SPIRAM_MALLOC_ALWAYSINTERNAL=1024
CONFIG_SPIRAM_MALLOC_RESERVE_INTERNAL=65536
CONFIG_SPIRAM_TRY_ALLOCATE_WIFI_LWIP=y

# 为 Wi-Fi 管理帧和配网热点保留内部内存，降低吞吐优化的内存占用
CONFIG_ESP_WIFI_IRAM_OPT=n
CONFIG_ESP_WIFI_EXTRA_IRAM_OPT=n
CONFIG_ESP_WIFI_RX_IRAM_OPT=n
CONFIG_ESP_WIFI_STATIC_TX_BUFFER_NUM=8
CONFIG_MDNS_MEMORY_ALLOC_SPIRAM=y

# TLS 使用默认分配策略，大块缓冲优先使用 PSRAM
CONFIG_MBEDTLS_DEFAULT_MEM_ALLOC=y

# 多设备上报的 MQTT 缓冲优先放入 PSRAM，任务栈仍保留在内部 RAM
CONFIG_MQTT_USE_CUSTOM_CONFIG=y
CONFIG_MQTT_OUTBOX_DATA_ON_EXTERNAL_MEMORY=y
CONFIG_MQTT_BUFFERS_ON_EXTERNAL_MEMORY=y
```
